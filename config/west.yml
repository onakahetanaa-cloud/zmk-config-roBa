## config/west.yml
```yaml
manifest:
  version: 0.13
  remotes:
    - name: zmkfirmware
      url-base: https://github.com/zmkfirmware
    - name: kot149
      url-base: https://github.com/kot149
    - name: badjeff
      url-base: https://github.com/badjeff

  projects:
    - name: zmk
      remote: zmkfirmware
      revision: main
      import: app/west.yml

    - name: zmk-layout-shift
      remote: kot149
      revision: v1

    - name: zmk-pmw3610-driver
      remote: badjeff
      revision: main
      path: zmk-pmw3610-driver

  self:
    path: config
```
